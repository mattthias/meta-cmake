## conf/layer.conf
```bitbake
# We have a conf and classes directory, add to BBPATH
BBPATH_append = ":${LAYERDIR}"

# We have recipes-* directories, add to BBFILES
BBFILES += "${LAYERDIR}/recipes-*/*/*.bb \
            ${LAYERDIR}/recipes-*/*/*.bbappend"

BBFILE_COLLECTIONS += "meta-rocko-cmake"
BBFILE_PATTERN_meta-rocko-cmake = "^${LAYERDIR}/"
BBFILE_PRIORITY_meta-rocko-cmake = "6"
```
